## drivers/huawei_platform/hw_devices/Kconfig
```kconfig
config HW_DEVICE_DETECT
     bool "huawei_device_detect support"
        default n
```

## drivers/log_usertype/Kconfig
```kconfig
config HUAWEI_USERTYPE
       bool "/proc/log-usertype support"
       default y
       help
       set beta or commercial version to kernel.
```
