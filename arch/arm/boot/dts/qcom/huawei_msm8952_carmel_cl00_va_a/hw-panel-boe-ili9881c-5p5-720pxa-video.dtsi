/* Copyright (c) 2013, The Linux Foundation. All rights reserved.
 *
 * This program is free software; you can redistribute it and/or modify
 * it under the terms of the GNU General Public License version 2 and
 * only version 2 as published by the Free Software Foundation.
 *
 * This program is distributed in the hope that it will be useful,
 * but WITHOUT ANY WARRANTY; without even the implied warranty of
 * MERCHANTABILITY or FITNESS FOR A PARTICULAR PURPOSE.  See the
 * GNU General Public License for more details.
 */

/*---------------------------------------------------------------------------
 * This file is autogenerated file using gcdb parser. Please do not edit it.
 * Update input XML file to add a new entry or update variable in this file
 * VERSION = "1.0"
 *---------------------------------------------------------------------------*/
&mdss_mdp {
	dsi_boe_ili9881c_5p5_720pxa_video: qcom,mdss_dsi_boe_ili9881c_5p5_720pxa_video {
		qcom,mdss-dsi-panel-name = "BOE_ILI9881C_5P5_720PXA_VIDEO";
		qcom,cont-splash-enabled;
		qcom,mdss-dsi-panel-controller = <&mdss_dsi0>;
		qcom,panel-supply-entries = <&dsi_panel_pwr_supply>;
		qcom,mdss-dsi-panel-type = "dsi_video_mode";
		qcom,mdss-dsi-panel-destination = "display_1";
		qcom,mdss-dsi-panel-clockrate = <455540000>;
		qcom,mdss-dsi-panel-framerate = <60>;
		qcom,mdss-dsi-virtual-channel-id = <0>;
		qcom,mdss-dsi-stream = <0>;
		qcom,mdss-dsi-panel-width = <720>;
		qcom,mdss-dsi-panel-height = <1280>;
		qcom,mdss-dsi-h-front-porch = <200>;
		qcom,mdss-dsi-h-back-porch = <28>;
		qcom,mdss-dsi-h-pulse-width = <2>;
		qcom,mdss-dsi-h-sync-skew = <0>;
		qcom,mdss-dsi-v-back-porch = <25>;
		qcom,mdss-dsi-v-front-porch = <25>;
		qcom,mdss-dsi-v-pulse-width = <2>;
		qcom,mdss-dsi-h-left-border = <0>;
		qcom,mdss-dsi-h-right-border = <0>;
		qcom,mdss-dsi-v-top-border = <0>;
		qcom,mdss-dsi-v-bottom-border = <0>;
		qcom,mdss-dsi-bpp = <24>;
		qcom,mdss-dsi-underflow-color = <0x00>;
		qcom,mdss-dsi-border-color = <0>;
		qcom,mdss-dsi-color-order = "rgb_swap_rgb";
		qcom,mdss-dsi-on-command = [29 01 00 00 00 00 04 FF 98 81 03
		29 01 00 00 00 00 02 01 00
		29 01 00 00 00 00 02 02 00
		29 01 00 00 00 00 02 03 73
		29 01 00 00 00 00 02 04 00
		29 01 00 00 00 00 02 05 00
		29 01 00 00 00 00 02 06 0c
		29 01 00 00 00 00 02 07 00
		29 01 00 00 00 00 02 08 00
		29 01 00 00 00 00 02 09 19
		29 01 00 00 00 00 02 0a 01
		29 01 00 00 00 00 02 0b 01
		29 01 00 00 00 00 02 0c 0b
		29 01 00 00 00 00 02 0d 01
		29 01 00 00 00 00 02 0e 01
		29 01 00 00 00 00 02 0f 19
		29 01 00 00 00 00 02 10 1d
		29 01 00 00 00 00 02 11 00
		29 01 00 00 00 00 02 12 00
		29 01 00 00 00 00 02 13 02
		29 01 00 00 00 00 02 14 00
		29 01 00 00 00 00 02 15 00
		29 01 00 00 00 00 02 16 00
		29 01 00 00 00 00 02 17 00
		29 01 00 00 00 00 02 18 00
		29 01 00 00 00 00 02 19 00
		29 01 00 00 00 00 02 1a 00
		29 01 00 00 00 00 02 1b 00
		29 01 00 00 00 00 02 1c 00
		29 01 00 00 00 00 02 1d 00
		29 01 00 00 00 00 02 1e 44
		29 01 00 00 00 00 02 1f c0
		29 01 00 00 00 00 02 20 0a
		29 01 00 00 00 00 02 21 03
		29 01 00 00 00 00 02 22 0a
		29 01 00 00 00 00 02 23 00
		29 01 00 00 00 00 02 24 8c
		29 01 00 00 00 00 02 25 8c
		29 01 00 00 00 00 02 26 00
		29 01 00 00 00 00 02 27 00
		29 01 00 00 00 00 02 28 3b
		29 01 00 00 00 00 02 29 03
		29 01 00 00 00 00 02 2a 00
		29 01 00 00 00 00 02 2b 00
		29 01 00 00 00 00 02 2c 00
		29 01 00 00 00 00 02 2d 00
		29 01 00 00 00 00 02 2e 00
		29 01 00 00 00 00 02 2f 00
		29 01 00 00 00 00 02 30 00
		29 01 00 00 00 00 02 31 00
		29 01 00 00 00 00 02 32 00
		29 01 00 00 00 00 02 33 00
		29 01 00 00 00 00 02 34 00
		29 01 00 00 00 00 02 35 00
		29 01 00 00 00 00 02 36 00
		29 01 00 00 00 00 02 37 00
		29 01 00 00 00 00 02 38 00
		29 01 00 00 00 00 02 39 00
		29 01 00 00 00 00 02 3a 00
		29 01 00 00 00 00 02 3b 00
		29 01 00 00 00 00 02 3c 00
		29 01 00 00 00 00 02 3d 00
		29 01 00 00 00 00 02 3e 00
		29 01 00 00 00 00 02 3f 00
		29 01 00 00 00 00 02 40 00
		29 01 00 00 00 00 02 41 00
		29 01 00 00 00 00 02 42 00
		29 01 00 00 00 00 02 43 00
		29 01 00 00 00 00 02 44 00
		29 01 00 00 00 00 02 50 01
		29 01 00 00 00 00 02 51 23
		29 01 00 00 00 00 02 52 45
		29 01 00 00 00 00 02 53 67
		29 01 00 00 00 00 02 54 89
		29 01 00 00 00 00 02 55 ab
		29 01 00 00 00 00 02 56 01
		29 01 00 00 00 00 02 57 23
		29 01 00 00 00 00 02 58 45
		29 01 00 00 00 00 02 59 67
		29 01 00 00 00 00 02 5a 89
		29 01 00 00 00 00 02 5b ab
		29 01 00 00 00 00 02 5c cd
		29 01 00 00 00 00 02 5d ef
		29 01 00 00 00 00 02 5e 11
		29 01 00 00 00 00 02 5f 02
		29 01 00 00 00 00 02 60 00
		29 01 00 00 00 00 02 61 0c
		29 01 00 00 00 00 02 62 0d
		29 01 00 00 00 00 02 63 0e
		29 01 00 00 00 00 02 64 0f
		29 01 00 00 00 00 02 65 02
		29 01 00 00 00 00 02 66 02
		29 01 00 00 00 00 02 67 02
		29 01 00 00 00 00 02 68 02
		29 01 00 00 00 00 02 69 02
		29 01 00 00 00 00 02 6a 02
		29 01 00 00 00 00 02 6b 02
		29 01 00 00 00 00 02 6c 02
		29 01 00 00 00 00 02 6d 02
		29 01 00 00 00 00 02 6e 05
		29 01 00 00 00 00 02 6f 05
		29 01 00 00 00 00 02 70 05
		29 01 00 00 00 00 02 71 05
		29 01 00 00 00 00 02 72 01
		29 01 00 00 00 00 02 73 06
		29 01 00 00 00 00 02 74 07
		29 01 00 00 00 00 02 75 02
		29 01 00 00 00 00 02 76 00
		29 01 00 00 00 00 02 77 0c
		29 01 00 00 00 00 02 78 0d
		29 01 00 00 00 00 02 79 0e
		29 01 00 00 00 00 02 7a 0f
		29 01 00 00 00 00 02 7b 02
		29 01 00 00 00 00 02 7c 02
		29 01 00 00 00 00 02 7d 02
		29 01 00 00 00 00 02 7e 02
		29 01 00 00 00 00 02 7f 02
		29 01 00 00 00 00 02 80 02
		29 01 00 00 00 00 02 81 02
		29 01 00 00 00 00 02 82 02
		29 01 00 00 00 00 02 83 02
		29 01 00 00 00 00 02 84 05
		29 01 00 00 00 00 02 85 05
		29 01 00 00 00 00 02 86 05
		29 01 00 00 00 00 02 87 05
		29 01 00 00 00 00 02 88 01
		29 01 00 00 00 00 02 89 06
		29 01 00 00 00 00 02 8a 07
		29 01 00 00 00 00 04 ff 98 81 04
		29 01 00 00 00 00 02 6c 15
		29 01 00 00 00 00 02 6e 19
		29 01 00 00 00 00 02 6f 25
		29 01 00 00 00 00 02 3a 24
		29 01 00 00 00 00 02 35 1f
		29 01 00 00 00 00 02 8d 1f
		29 01 00 00 00 00 02 87 ba
		29 01 00 00 00 00 02 97 00
		29 01 00 00 00 00 02 98 00
		29 01 00 00 00 00 02 7a 10
		29 01 00 00 00 00 02 71 b0
		29 01 00 00 00 00 04 ff 98 81 01
		29 01 00 00 00 00 02 22 0a
		29 01 00 00 00 00 02 31 00
		29 01 00 00 00 00 02 40 53
		29 01 00 00 00 00 02 43 66
		29 01 00 00 00 00 02 50 a6
		29 01 00 00 00 00 02 51 a1
		29 01 00 00 00 00 02 60 15
		29 01 00 00 00 00 02 61 01
		29 01 00 00 00 00 02 62 0c
		29 01 00 00 00 00 02 63 00
		29 01 00 00 00 00 02 a0 00
		29 01 00 00 00 00 02 a1 13
		29 01 00 00 00 00 02 a2 1f
		29 01 00 00 00 00 02 a3 11
		29 01 00 00 00 00 02 a4 10
		29 01 00 00 00 00 02 a5 28
		29 01 00 00 00 00 02 a6 1A
		29 01 00 00 00 00 02 a7 1D
		29 01 00 00 00 00 02 a8 6d
		29 01 00 00 00 00 02 a9 1C
		29 01 00 00 00 00 02 aa 27
		29 01 00 00 00 00 02 ab 59
		29 01 00 00 00 00 02 ac 16
		29 01 00 00 00 00 02 ad 13
		29 01 00 00 00 00 02 ae 46
		29 01 00 00 00 00 02 af 1D
		29 01 00 00 00 00 02 b0 26
		29 01 00 00 00 00 02 b1 52
		29 01 00 00 00 00 02 b2 64
		29 01 00 00 00 00 02 b3 3F
		29 01 00 00 00 00 02 c0 00
		29 01 00 00 00 00 02 c1 13
		29 01 00 00 00 00 02 c2 1f
		29 01 00 00 00 00 02 c3 11
		29 01 00 00 00 00 02 c4 10
		29 01 00 00 00 00 02 c5 28
		29 01 00 00 00 00 02 c6 1A
		29 01 00 00 00 00 02 c7 1D
		29 01 00 00 00 00 02 c8 6D
		29 01 00 00 00 00 02 c9 1C
		29 01 00 00 00 00 02 ca 27
		29 01 00 00 00 00 02 cb 59
		29 01 00 00 00 00 02 cc 16
		29 01 00 00 00 00 02 cd 13
		29 01 00 00 00 00 02 ce 46
		29 01 00 00 00 00 02 cf 1d
		29 01 00 00 00 00 02 d0 26
		29 01 00 00 00 00 02 d1 52
		29 01 00 00 00 00 02 d2 64
		29 01 00 00 00 00 02 d3 3f
		29 01 00 00 00 00 04 ff 98 8102
		29 01 00 00 00 00 02 06 20
		29 01 00 00 00 00 02 07 00
		29 01 00 00 00 00 02 00 fb
		29 01 00 00 00 00 02 01 3f
		29 01 00 00 00 00 02 02 f6
		29 01 00 00 00 00 02 08 30
		29 01 00 00 00 00 02 20 3e
		29 01 00 00 00 00 02 21 3e
		29 01 00 00 00 00 02 22 3e
		29 01 00 00 00 00 02 23 3d
		29 01 00 00 00 00 02 24 3c
		29 01 00 00 00 00 02 25 3c
		29 01 00 00 00 00 02 26 38
		29 01 00 00 00 00 02 29 29
		29 01 00 00 00 00 02 2c fe
		29 01 00 00 00 00 02 2d 3e
		29 01 00 00 00 00 02 2e fd
		29 01 00 00 00 00 02 2f 3c
		29 01 00 00 00 00 02 30 38
		29 01 00 00 00 00 02 31 b4
		29 01 00 00 00 00 02 32 b0
		29 01 00 00 00 00 02 33 ee
		29 01 00 00 00 00 02 34 fe
		29 01 00 00 00 00 02 35 3e
		29 01 00 00 00 00 02 36 fd
		29 01 00 00 00 00 02 03 08
		29 01 00 00 00 00 02 04 00
		29 01 00 00 00 00 02 05 00
		29 01 00 00 00 00 04 ff 98 8100
		05 01 00 00 78 00 02 11 00
		05 01 00 00 14 00 02 29 00];
		qcom,mdss-dsi-off-command = [05 01 00 00 14 00 02 28 00
				05 01 00 00 78 00 02 10 00];
		qcom,mdss-dsi-on-command-state = "dsi_lp_mode";
		qcom,mdss-dsi-off-command-state = "dsi_lp_mode";
		qcom,mdss-dsi-h-sync-pulse = <1>;
		qcom,mdss-dsi-traffic-mode = "burst_mode";
		qcom,mdss-dsi-lane-map = "lane_map_0123";
		qcom,mdss-dsi-bllp-eof-power-mode;
		qcom,mdss-dsi-bllp-power-mode;
		qcom,mdss-dsi-lane-0-state;
		qcom,mdss-dsi-lane-1-state;
		qcom,mdss-dsi-lane-2-state;
		qcom,mdss-dsi-lane-3-state;
		qcom,mdss-dsi-panel-timings = [87 1C 12 00 42 42 18 20 17 03 04 00];
		qcom,mdss-dsi-t-clk-post = <0x2C>;
		qcom,mdss-dsi-t-clk-pre = <0x2B>;
		qcom,mdss-dsi-bl-min-level = <40>;
		qcom,mdss-dsi-bl-max-level = <4095>;
		qcom,mdss-brightness-max-level = <4095>;
		qcom,mdss-dsi-dma-trigger = "trigger_sw";
		qcom,mdss-dsi-mdp-trigger = "none";
		qcom,mdss-dsi-bl-pmic-control-type = "bl_ctrl_wled";
		qcom,panel-dot-inversion-mode-cmds = [39 01 00 00 00 00 04 FF 98 81 01
			39 01 00 00 00 00 02 31 01
			39 01 00 00 00 00 04 FF 98 81 00];
		qcom,panel-column-inversion-mode-cmds = [39 01 00 00 00 00 04 FF 98 81 01
			39 01 00 00 00 00 02 31 00
			39 01 00 00 00 00 04 FF 98 81 00];
		qcom,dot-inversion-cmds-dsi-state = "dsi_lp_mode";
		qcom,column-inversion-cmds-dsi-state = "dsi_lp_mode";
		qcom,panel-forword-scan-mode-cmds = [39 01 00 00 00 00 04 FF 98 81 01
			39 01 00 00 00 00 02 22 0A
			39 01 00 00 00 00 04 FF 98 81 00];
		qcom,panel-revert-scan-mode-cmds = [39 01 00 00 00 00 04 FF 98 81 01
			39 01 00 00 00 00 02 22 09
			39 01 00 00 00 00 04 FF 98 81 00];
		qcom,forword-scan-cmds-dsi-state = "dsi_lp_mode";
		qcom,revert-scan-cmds-dsi-state = "dsi_lp_mode";
		qcom,panel-esd-check-enabled;
		qcom,panel-esd-read-commands = [06 01 00 01 05 00 02 0A 9C
			06 01 00 01 05 00 02 0B 00];
		qcom,esd-read-cmds-state = "dsi_lp_mode";
		qcom,mdss-dsi-lp11-init;
		qcom,mdss-pan-physical-width-dimension = <68>;
		qcom,mdss-pan-physical-height-dimension = <121>;
		huawei,delaytime-before-bl = <80>;
		huawei,reg-read-local-flag = <1>;
		qcom,mdss-dsi-reset-sequence = <1 5>, <0 5>, <1 20>;

	};
};
