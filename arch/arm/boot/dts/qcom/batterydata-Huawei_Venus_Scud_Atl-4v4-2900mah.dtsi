qcom,2306188_huawei_venusscud_2900mah_averaged_masterslave_jan12th2016 {
	/* #2306188_Huawei_VenusScud_2900mAh_averaged_MasterSlave_Jan12th2016*/
	qcom,max-voltage-uv = <4400000>;
	qcom,nom-batt-capacity-mah = <2900>;
	qcom,batt-id-kohm = <35>;
	qcom,battery-beta = <3435>;
	qcom,battery-type = "scud_atl_650b";
	qcom,fastchg-current-ma = <1900>;
	qcom,fg-cc-cv-threshold-mv = <4390>;
	qcom,fg-iterm-ma = <200>;
	qcom,fg-chg-iterm-ma = <150>;
	qcom,chg-rslow-comp-c1 = <2831949>;
	qcom,chg-rslow-comp-c2 = <3434569>;
	qcom,chg-rs-to-rslow = <1081887>;
	qcom,chg-rslow-comp-thr = <0x99>;
	qcom,checksum = <0x692C>;
	qcom,gui-version = "PMI8950GUI - 2.0.0.15";
	qcom,fg-profile-data = [
		 F8 83 A2 7D 
		 A7 81 26 7C 
		 48 83 E1 6B 
		 9B 49 A2 6F 
		 3F 82 89 98 
		 15 B6 76 C1 
		 58 19 02 88 
		 97 7D 8A 81 
		 FA 77 57 83 
		 52 68 07 7B 
		 D4 87 4D 82 
		 B7 99 06 BD 
		 FA C9 59 0D 
		 9F 0B CE 59 
		 14 70 29 FC 
		 35 44 C6 3F 
		 97 40 00 00 
		 D0 45 C1 25 
		 5F 38 00 00 
		 00 00 00 00 
		 00 00 00 00 
		 75 70 5E 6B 
		 79 61 14 83 
		 03 74 54 60 
		 EE 38 A8 79 
		 8E 6E 1A 59 
		 F9 74 F8 98 
		 1D AE 63 47 
		 66 A0 71 0C 
		 28 00 FF 36 
		 F0 11 30 03 
		 00 00 00 0C 
	];
};
