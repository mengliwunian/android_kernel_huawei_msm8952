 / {
        huawei_fac_info {
                  compatible = "huawei,hw_fac_info";
                  fac,product_name = "HUAWEI CAM-L32";
                  fac,hardware_ver = "HL5CAM1TM";
                  fac,software_ver = "MSM8952_CAM_L32_VA";
                  status = "ok";
        };
};
