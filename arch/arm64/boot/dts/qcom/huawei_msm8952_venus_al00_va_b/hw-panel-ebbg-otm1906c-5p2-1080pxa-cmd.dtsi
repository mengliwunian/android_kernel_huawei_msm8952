/* Copyright (c) 2013, The Linux Foundation. All rights reserved.
 *
 * This program is free software; you can redistribute it and/or modify
 * it under the terms of the GNU General Public License version 2 and
 * only version 2 as published by the Free Software Foundation.
 *
 * This program is distributed in the hope that it will be useful,
 * but WITHOUT ANY WARRANTY; without even the implied warranty of
 * MERCHANTABILITY or FITNESS FOR A PARTICULAR PURPOSE.  See the
 * GNU General Public License for more details.
 */

/*---------------------------------------------------------------------------
 * This file is autogenerated file using gcdb parser. Please do not edit it.
 * Update input XML file to add a new entry or update variable in this file
 * VERSION = "1.0"
 *---------------------------------------------------------------------------*/
&mdss_mdp {
	dsi_ebbg_otm1906c_5p2_1080pxa_cmd: qcom,mdss_dsi_ebbg_otm1906c_5p2_1080pxa_cmd {
		qcom,mdss-dsi-panel-name = "EBBG_OTM1906C_5P2_1080PXA_CMD";
		qcom,cont-splash-enabled;
		qcom,mdss-dsi-panel-controller = <&mdss_dsi0>;
		qcom,panel-supply-entries = <&dsi_panel_pwr_supply>;
		qcom,mdss-dsi-panel-type = "dsi_cmd_mode";
		qcom,mdss-dsi-panel-destination = "display_1";
		qcom,mdss-dsi-panel-clockrate = <896000000>;
		qcom,mdss-dsi-panel-framerate = <60>;
		qcom,mdss-dsi-virtual-channel-id = <0>;
		qcom,mdss-dsi-stream = <0>;
		qcom,mdss-dsi-panel-width = <1080>;
		qcom,mdss-dsi-panel-height = <1920>;
		qcom,mdss-dsi-h-front-porch = <45>;
		qcom,mdss-dsi-h-back-porch = <45>;
		qcom,mdss-dsi-h-pulse-width = <8>;
		qcom,mdss-dsi-h-sync-skew = <0>;
		qcom,mdss-dsi-v-back-porch = <16>;
		qcom,mdss-dsi-v-front-porch = <16>;
		qcom,mdss-dsi-v-pulse-width = <4>;
		qcom,mdss-dsi-h-left-border = <0>;
		qcom,mdss-dsi-h-right-border = <0>;
		qcom,mdss-dsi-v-top-border = <0>;
		qcom,mdss-dsi-v-bottom-border = <0>;
		qcom,mdss-dsi-bpp = <24>;
		qcom,mdss-dsi-underflow-color = <0x00>;
		qcom,mdss-dsi-border-color = <0>;
		qcom,mdss-dsi-color-order = "rgb_swap_rgb";
		qcom,mdss-dsi-on-command = [15 01 00 00 00 00 02 00 00
					39 01 00 00 00 00 04 FF 19 06 01
					15 01 00 00 00 00 02 00 80
					39 01 00 00 00 00 03 FF 19 06
					15 01 00 00 00 00 02 00 84
					15 01 00 00 00 00 02 ab bf
					15 01 00 00 00 00 02 00 85
					15 01 00 00 00 00 02 ab ff
					15 01 00 00 00 00 02 00 a7
					15 01 00 00 00 00 02 ab 07
					15 01 00 00 00 00 02 00 d5
					15 01 00 00 00 00 02 a7 35
					15 01 00 00 00 00 02 00 98
					15 01 00 00 00 00 02 a7 06
					15 01 00 00 00 00 02 00 99
					15 01 00 00 00 00 02 a7 60
					15 01 00 00 00 00 02 00 00
					15 01 00 00 00 00 02 fb 01
					29 01 00 00 00 00 02 00 90
					29 01 00 00 00 00 02 B0 00
					29 01 00 00 00 00 02 00 00
					29 01 00 00 00 00 03 44 07 70
					29 01 00 00 00 00 02 00 00
					29 01 00 00 00 00 04 FF FF FF FF
					29 01 00 00 00 00 05 2A 00 00 04 37
					29 01 00 00 00 00 05 2B 00 00 07 7F
					15 01 00 00 00 00 02 35 00
					05 01 00 00 78 00 02 11 00
					05 01 00 00 00 00 02 29 00
					29 01 00 00 00 00 03 99 00 00];
		qcom,mdss-dsi-off-command = [29 01 00 00 00 00 03 99 95 27
				 05 01 00 00 00 00 02 28 00
					05 01 00 00 78 00 02 10 00];
		qcom,mdss-dsi-on-command-state = "dsi_lp_mode";
		qcom,mdss-dsi-off-command-state = "dsi_lp_mode";
		qcom,mdss-dsi-h-sync-pulse = <1>;
		qcom,mdss-dsi-traffic-mode = "burst_mode";
		qcom,mdss-dsi-lane-map = "lane_map_0123";
		qcom,mdss-dsi-bllp-eof-power-mode;
		qcom,mdss-dsi-bllp-power-mode;
		qcom,mdss-dsi-lane-0-state;
		qcom,mdss-dsi-lane-1-state;
		qcom,mdss-dsi-lane-2-state;
		qcom,mdss-dsi-lane-3-state;
		qcom,mdss-dsi-te-pin-select = <1>;
		qcom,mdss-dsi-te-v-sync-rd-ptr-irq-line = <0x2c>;
		qcom,mdss-dsi-te-dcs-command = <1>;
		qcom,mdss-dsi-te-check-enable;
		qcom,mdss-dsi-te-using-te-pin;
		qcom,mdss-dsi-panel-timings = [E6 38 26 00 68 6C 2A 3C 2C 03 04 00];
		qcom,mdss-dsi-t-clk-post = <0x2C>;
		qcom,mdss-dsi-t-clk-pre = <0x2B>;
		qcom,mdss-dsi-bl-min-level = <40>;
		qcom,mdss-dsi-bl-max-level = <4095>;
		qcom,mdss-brightness-max-level = <4095>;
		qcom,mdss-dsi-dma-trigger = "trigger_sw";
		qcom,mdss-dsi-mdp-trigger = "none";
		qcom,mdss-dsi-bl-pmic-control-type = "bl_ctrl_wled";
		qcom,panel-dot-inversion-mode-cmds = [29 01 00 00 00 00 02 00 00
                          29 01 00 00 00 00 04 FF 19 06 01
                          29 01 00 00 00 00 02 00 80
                          29 01 00 00 00 00 03 FF 19 06
                          29 01 00 00 00 00 02 00 B3
                          29 01 00 00 00 00 02 C0 00
                          29 01 00 00 00 00 02 00 00
                          29 01 00 00 00 00 02 FB 01
                          29 01 00 00 00 00 02 00 00
                          29 01 00 00 00 00 04 FF FF FF FF];
		qcom,panel-column-inversion-mode-cmds = [29 01 00 00 00 00 02 00 00
                             29 01 00 00 00 00 04 FF 19 06 01
                             29 01 00 00 00 00 02 00 80
                             29 01 00 00 00 00 03 FF 19 06
                             29 01 00 00 00 00 02 00 B3
                             29 01 00 00 00 00 02 C0 88
                             29 01 00 00 00 00 02 00 00
                             29 01 00 00 00 00 02 FB 01
                             29 01 00 00 00 00 02 00 00
                             29 01 00 00 00 00 04 FF FF FF FF];
		qcom,dot-inversion-cmds-dsi-state = "dsi_lp_mode";
		qcom,column-inversion-cmds-dsi-state = "dsi_lp_mode";
		qcom,panel-forword-scan-mode-cmds = [29 01 00 00 00 00 02 00 00
				29 01 00 00 00 00 04 FF 19 06 01
				29 01 00 00 00 00 02 00 80
				29 01 00 00 00 00 03 FF 19 06
				29 01 00 00 00 00 02 00 B4
				29 01 00 00 00 00 02 C0 00
				29 01 00 00 00 00 02 00 00
				29 01 00 00 00 00 02 FB 01
				29 01 00 00 00 00 02 00 00
				29 01 00 00 00 00 04 FF FF FF FF];
		qcom,panel-revert-scan-mode-cmds = [29 01 00 00 00 00 02 00 00
				29 01 00 00 00 00 04 FF 19 06 01
				29 01 00 00 00 00 02 00 80
				29 01 00 00 00 00 03 FF 19 06
				29 01 00 00 00 00 02 00 B4
				29 01 00 00 00 00 02 C0 50
				29 01 00 00 00 00 02 00 00
				29 01 00 00 00 00 02 FB 01
				29 01 00 00 00 00 02 00 00
				29 01 00 00 00 00 04 FF FF FF FF];
		qcom,forword-scan-cmds-dsi-state = "dsi_lp_mode";
		qcom,revert-scan-cmds-dsi-state = "dsi_lp_mode";
		qcom,panel-esd-check-enabled;
		qcom,panel-esd-read-commands = [06 01 00 01 05 00 02 0A 9C];
		qcom,esd-read-cmds-state = "dsi_hs_mode";
		qcom,mdss-dsi-lp11-init;
		qcom,mdss-pan-physical-width-dimension = <65>;
		qcom,mdss-pan-physical-height-dimension = <115>;
		huawei,delaytime-before-bl = <80>;
		qcom,mdss-dsi-reset-sequence = <1 15>, <0 5>, <1 15>;

	};
};
