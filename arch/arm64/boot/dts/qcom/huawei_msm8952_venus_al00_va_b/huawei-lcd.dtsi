/*---------------------------------------------------------------------------
 * This file is autogenerated file using huawei LCD parser. Please do not edit it.
 * Update input XML file to add a new entry or update variable in this file
 * Parser location: device/qcom/common/display/tools/huawei_lcd_panel 
 *---------------------------------------------------------------------------*/


#include "hw-panel-boe-otm1906c-5p2-1080pxa-cmd.dtsi"
#include "hw-panel-ebbg-otm1906c-5p2-1080pxa-cmd.dtsi"
#include "hw-panel-inx-otm1906c-5p2-1080pxa-cmd.dtsi"
#include "hw-panel-jdi-nt35695-5p2-1080pxa-cmd.dtsi"
#include "hw-panel-lg-r69006-5p2-1080pxa-cmd.dtsi"
