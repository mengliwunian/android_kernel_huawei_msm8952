/* Copyright (c) 2013, The Linux Foundation. All rights reserved.
 *
 * This program is free software; you can redistribute it and/or modify
 * it under the terms of the GNU General Public License version 2 and
 * only version 2 as published by the Free Software Foundation.
 *
 * This program is distributed in the hope that it will be useful,
 * but WITHOUT ANY WARRANTY; without even the implied warranty of
 * MERCHANTABILITY or FITNESS FOR A PARTICULAR PURPOSE.  See the
 * GNU General Public License for more details.
 */

/*---------------------------------------------------------------------------
 * This file is autogenerated file using gcdb parser. Please do not edit it.
 * Update input XML file to add a new entry or update variable in this file
 * VERSION = "1.0"
 *---------------------------------------------------------------------------*/
&mdss_mdp {
	dsi_tm_hx8394f_5p5_720pxa_video: qcom,mdss_dsi_tm_hx8394f_5p5_720pxa_video {
		qcom,mdss-dsi-panel-name = "TM_HX8394F_5P5_720PXA_VIDEO";
		qcom,cont-splash-enabled;
		qcom,mdss-dsi-panel-controller = <&mdss_dsi0>;
		qcom,panel-supply-entries = <&dsi_panel_pwr_supply>;
		qcom,mdss-dsi-panel-type = "dsi_video_mode";
		qcom,mdss-dsi-panel-destination = "display_1";
		qcom,mdss-dsi-panel-clockrate = <455320000>;
		qcom,mdss-dsi-panel-framerate = <60>;
		qcom,mdss-dsi-virtual-channel-id = <0>;
		qcom,mdss-dsi-stream = <0>;
		qcom,mdss-dsi-panel-width = <720>;
		qcom,mdss-dsi-panel-height = <1280>;
		qcom,mdss-dsi-h-front-porch = <72>;
		qcom,mdss-dsi-h-back-porch = <148>;
		qcom,mdss-dsi-h-pulse-width = <24>;
		qcom,mdss-dsi-h-sync-skew = <0>;
		qcom,mdss-dsi-v-back-porch = <12>;
		qcom,mdss-dsi-v-front-porch = <16>;
		qcom,mdss-dsi-v-pulse-width = <4>;
		qcom,mdss-dsi-h-left-border = <0>;
		qcom,mdss-dsi-h-right-border = <0>;
		qcom,mdss-dsi-v-top-border = <0>;
		qcom,mdss-dsi-v-bottom-border = <0>;
		qcom,mdss-dsi-bpp = <24>;
		qcom,mdss-dsi-underflow-color = <0x00>;
		qcom,mdss-dsi-border-color = <0>;
		qcom,mdss-dsi-color-order = "rgb_swap_rgb";
		qcom,mdss-dsi-on-command = [39 01 00 00 00 00 04 B9 FF 83 94
			39 01 00 00 00 00 07 BA 63 03 68 6B B2 C0
			39 01 00 00 00 00 0b B1 50 0B 71 89 33 22 70 30 43 2F
			39 01 00 00 00 00 07 B2 00 80 64 0E 0E 48
			39 01 00 00 00 00 16 B4 04 74 04 74 04 74 01 05 92 66 00 3F 04 74 04 74 04 74 01 05 92
			39 01 00 00 00 00 22 D3 00 00 10 10 00 00 08 00 32 10 05 00 05 32 10 01 00 01 32 10 00 00 00 36 03 09 09 37 00 00 37 0E 40
			39 01 00 00 00 00 2d D5 02 03 00 01 06 07 04 05 20 21 22 23 18 18 18 18 18 18 18 18 18 18 18 18 18 18 18 18 18 18 18 18 18 18 18 18 18 18 24 25 18 18 19 19
			39 01 00 00 00 00 2d D6 05 04 07 06 01 00 03 02 23 22 21 20 18 18 18 18 18 18 18 18 18 18 18 18 18 18 18 18 18 18 18 18 18 18 18 18 18 18 25 24 19 19 18 18
			39 01 00 00 00 00 3b E0 00 1C 29 2F 32 36 39 37 72 81 91 90 96 A9 AD AF BA B9 B1 B9 C4 5F 5C 5D 5F 5F 63 73 7A 00 1C 29 2F 32 36 39 37 72 81 91 90 96 A9 AD AF BA B9 B1 B9 C4 5F 5C 5D 5F 5F 63 73 7A
			39 01 00 00 00 00 02 CC 0B
			39 01 00 00 00 00 03 C0 1F 73
			39 01 00 00 00 00 02 D4 02
			39 01 00 00 00 00 02 BD 01
			39 01 00 00 00 00 02 B1 60
			05 01 00 00 82 00 02 11 00
			05 01 00 00 0A 00 02 29 00];
		qcom,mdss-dsi-off-command = [05 01 00 00 3C 00 02 28 00
				05 01 00 00 78 00 02 10 00];
		qcom,mdss-dsi-on-command-state = "dsi_lp_mode";
		qcom,mdss-dsi-off-command-state = "dsi_lp_mode";
		qcom,mdss-dsi-h-sync-pulse = <1>;
		qcom,mdss-dsi-traffic-mode = "burst_mode";
		qcom,mdss-dsi-lane-map = "lane_map_0123";
		qcom,mdss-dsi-bllp-eof-power-mode;
		qcom,mdss-dsi-bllp-power-mode;
		qcom,mdss-dsi-lane-0-state;
		qcom,mdss-dsi-lane-1-state;
		qcom,mdss-dsi-lane-2-state;
		qcom,mdss-dsi-lane-3-state;
		qcom,mdss-dsi-panel-timings = [87 1C 12 00 42 42 18 20 17 03 04 00];
		qcom,mdss-dsi-t-clk-post = <0x2C>;
		qcom,mdss-dsi-t-clk-pre = <0x2B>;
		qcom,mdss-dsi-bl-min-level = <40>;
		qcom,mdss-dsi-bl-max-level = <4095>;
		qcom,mdss-brightness-max-level = <4095>;
		qcom,mdss-dsi-dma-trigger = "trigger_sw";
		qcom,mdss-dsi-mdp-trigger = "none";
		qcom,mdss-dsi-bl-pmic-control-type = "bl_ctrl_wled";
		qcom,panel-dot-inversion-mode-cmds = [39 01 00 00 00 00 07 B2 01 80 64 2E 0C 2F];
		qcom,panel-column-inversion-mode-cmds = [39 01 00 00 00 00 07 B2 00 80 64 2E 0C 2F];
		qcom,dot-inversion-cmds-dsi-state = "dsi_lp_mode";
		qcom,column-inversion-cmds-dsi-state = "dsi_lp_mode";
		qcom,panel-forword-scan-mode-cmds = [29 01 00 00 00 00 02 36 00];
		qcom,panel-revert-scan-mode-cmds = [29 01 00 00 00 00 02 36 01];
		qcom,forword-scan-cmds-dsi-state = "dsi_lp_mode";
		qcom,revert-scan-cmds-dsi-state = "dsi_lp_mode";
		qcom,panel-esd-check-enabled;
		qcom,panel-esd-read-commands = [14 01 00 01 05 00 02 0A 1C];
		qcom,esd-read-cmds-state = "dsi_hs_mode";
		qcom,mdss-dsi-lp11-init;
		qcom,mdss-pan-physical-width-dimension = <68>;
		qcom,mdss-pan-physical-height-dimension = <121>;
		huawei,delaytime-before-bl = <80>;
		huawei,long-read-flag = <1>;
		huawei,reg-read-gen-flag = <1>;
		huawei,reg-read-expect-value = <0x1C>;
		huawei,reg-long-read-count = <3>;
		qcom,mdss-dsi-reset-sequence = <1 5>, <0 5>, <1 60>;

	};
};
