 / {
        huawei_fac_info {
                  compatible = "huawei,hw_fac_info";
                  fac,product_name = "HUAWEI VNS-CL00";
                  fac,hardware_ver = "HL1VENUSM";
                  fac,software_ver = "MSM8952_VNS_CL00_VB";
                  status = "ok";
        };
};
