/* Copyright (c) 2013, The Linux Foundation. All rights reserved.
 *
 * This program is free software; you can redistribute it and/or modify
 * it under the terms of the GNU General Public License version 2 and
 * only version 2 as published by the Free Software Foundation.
 *
 * This program is distributed in the hope that it will be useful,
 * but WITHOUT ANY WARRANTY; without even the implied warranty of
 * MERCHANTABILITY or FITNESS FOR A PARTICULAR PURPOSE.  See the
 * GNU General Public License for more details.
 */

/*---------------------------------------------------------------------------
 * This file is autogenerated file using gcdb parser. Please do not edit it.
 * Update input XML file to add a new entry or update variable in this file
 * VERSION = "1.0"
 *---------------------------------------------------------------------------*/
&mdss_mdp {
	dsi_cmi_nt35521s_5p5_720pxa_video: qcom,mdss_dsi_cmi_nt35521s_5p5_720pxa_video {
		qcom,mdss-dsi-panel-name = "CMI_NT35521S_5P5_720PXA_VIDEO";
		qcom,cont-splash-enabled;
		qcom,mdss-dsi-panel-controller = <&mdss_dsi0>;
		qcom,panel-supply-entries = <&dsi_panel_pwr_supply>;
		qcom,mdss-dsi-panel-type = "dsi_video_mode";
		qcom,mdss-dsi-panel-destination = "display_1";
		qcom,mdss-dsi-panel-clockrate = <455540000>;
		qcom,mdss-dsi-panel-framerate = <60>;
		qcom,mdss-dsi-virtual-channel-id = <0>;
		qcom,mdss-dsi-stream = <0>;
		qcom,mdss-dsi-panel-width = <720>;
		qcom,mdss-dsi-panel-height = <1280>;
		qcom,mdss-dsi-h-front-porch = <200>;
		qcom,mdss-dsi-h-back-porch = <28>;
		qcom,mdss-dsi-h-pulse-width = <2>;
		qcom,mdss-dsi-h-sync-skew = <0>;
		qcom,mdss-dsi-v-back-porch = <25>;
		qcom,mdss-dsi-v-front-porch = <25>;
		qcom,mdss-dsi-v-pulse-width = <2>;
		qcom,mdss-dsi-h-left-border = <0>;
		qcom,mdss-dsi-h-right-border = <0>;
		qcom,mdss-dsi-v-top-border = <0>;
		qcom,mdss-dsi-v-bottom-border = <0>;
		qcom,mdss-dsi-bpp = <24>;
		qcom,mdss-dsi-underflow-color = <0x00>;
		qcom,mdss-dsi-border-color = <0>;
		qcom,mdss-dsi-color-order = "rgb_swap_rgb";
		qcom,mdss-dsi-on-command = [39 01 00 00 00 00 06 F0 55 AA 52 08 00
			39 01 00 00 00 00 03 BB 24 24
			39 01 00 00 00 00 05 B8 00 00 00 00
			39 01 00 00 00 00 02 C6 31
			39 01 00 00 00 00 06 F0 55 AA 52 08 05
			39 01 00 00 00 00 02 ED 33
			39 01 00 00 00 00 06 F0 55 AA 52 08 02
			39 01 00 00 00 00 02 ED 03
			39 01 00 00 00 00 02 EE 03
			39 01 00 00 00 00 11 B0 00 01 00 47 00 6D 00 88 00 9C 00 BC 00 D6 01 08
			39 01 00 00 00 00 11 B1 01 2E 01 69 01 93 01 D7 02 0F 02 10 02 46 02 82
			39 01 00 00 00 00 11 B2 02 A7 02 DA 02 FD 03 2F 03 4F 03 7B 03 9A 03 BC
			39 01 00 00 00 00 05 B3 03 D3 03 D6
			39 01 00 00 00 00 11 B4 00 01 00 40 00 67 00 84 00 98 00 B8 00 D3 01 05
			39 01 00 00 00 00 11 B5 01 2C 01 67 01 92 01 D6 02 0E 02 10 02 46 02 82
			39 01 00 00 00 00 11 B6 02 A7 02 DA 02 FD 03 2E 03 4E 03 78 03 95 03 B7
			39 01 00 00 00 00 05 B7 03 D2 03 D6
			39 01 00 00 00 00 11 B8 00 EC 00 F2 00 F8 01 02 01 0A 01 17 01 25 01 44
			39 01 00 00 00 00 11 B9 01 5E 01 8A 01 AC 01 E7 02 1A 02 1C 02 4F 02 89
			39 01 00 00 00 00 11 BA 02 AE 02 E3 03 08 03 46 03 60 03 7C 03 91 03 B3
			39 01 00 00 00 00 05 BB 03 D2 03 D6
			05 01 00 00 78 00 02 11 00
			05 01 00 00 14 00 02 29 00];
		qcom,mdss-dsi-off-command = [05 01 00 00 14 00 02 28 00
				05 01 00 00 78 00 02 10 00];
		qcom,mdss-dsi-on-command-state = "dsi_lp_mode";
		qcom,mdss-dsi-off-command-state = "dsi_lp_mode";
		qcom,mdss-dsi-h-sync-pulse = <1>;
		qcom,mdss-dsi-traffic-mode = "burst_mode";
		qcom,mdss-dsi-lane-map = "lane_map_0123";
		qcom,mdss-dsi-bllp-eof-power-mode;
		qcom,mdss-dsi-bllp-power-mode;
		qcom,mdss-dsi-lane-0-state;
		qcom,mdss-dsi-lane-1-state;
		qcom,mdss-dsi-lane-2-state;
		qcom,mdss-dsi-lane-3-state;
		qcom,mdss-dsi-panel-timings = [87 1C 12 00 42 42 18 20 17 03 04 00];
		qcom,mdss-dsi-t-clk-post = <0x2C>;
		qcom,mdss-dsi-t-clk-pre = <0x2B>;
		qcom,mdss-dsi-bl-min-level = <40>;
		qcom,mdss-dsi-bl-max-level = <4095>;
		qcom,mdss-brightness-max-level = <4095>;
		qcom,mdss-dsi-dma-trigger = "trigger_sw";
		qcom,mdss-dsi-mdp-trigger = "none";
		qcom,mdss-dsi-bl-pmic-control-type = "bl_ctrl_wled";
		qcom,panel-dot-inversion-mode-cmds = [39 01 00 00 00 00 06 F0 55 AA 52 08 00
			39 01 00 00 00 00 03 BC 01 01];
		qcom,panel-column-inversion-mode-cmds = [39 01 00 00 00 00 06 F0 55 AA 52 08 00
			39 01 00 00 00 00 03 BC 00 00];
		qcom,dot-inversion-cmds-dsi-state = "dsi_lp_mode";
		qcom,column-inversion-cmds-dsi-state = "dsi_lp_mode";
		qcom,panel-forword-scan-mode-cmds = [29 01 00 00 00 00 06 F0 55 AA 52 08 00
				29 01 00 00 00 00 03 B1 60 21];
		qcom,panel-revert-scan-mode-cmds = [29 01 00 00 00 00 06 F0 55 AA 52 08 00
				29 01 00 00 00 00 03 B1 60 25];
		qcom,forword-scan-cmds-dsi-state = "dsi_lp_mode";
		qcom,revert-scan-cmds-dsi-state = "dsi_lp_mode";
		qcom,mdss-dsi-lp11-init;
		qcom,mdss-pan-physical-width-dimension = <68>;
		qcom,mdss-pan-physical-height-dimension = <121>;
		huawei,delaytime-before-bl = <80>;
		qcom,mdss-dsi-reset-sequence = <1 5>, <0 5>, <1 40>;

	};
};
