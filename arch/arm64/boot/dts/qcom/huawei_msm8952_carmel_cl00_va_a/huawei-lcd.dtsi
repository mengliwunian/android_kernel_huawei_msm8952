/*---------------------------------------------------------------------------
 * This file is autogenerated file using huawei LCD parser. Please do not edit it.
 * Update input XML file to add a new entry or update variable in this file
 * Parser location: device/qcom/common/display/tools/huawei_lcd_panel 
 *---------------------------------------------------------------------------*/


#include "hw-panel-boe-ili9881c-5p5-720pxa-video.dtsi"
#include "hw-panel-cmi-nt35521s-5p5-720pxa-video.dtsi"
#include "hw-panel-tm-hx8394f-5p5-720pxa-video.dtsi"
