
qcom,2248205_huawei_carmel_3000mah_master_dec16th2015 {
	/* #2248205_Huawei_Carmel_3000mAh_Master_Dec16th2015*/
	qcom,max-voltage-uv = <4350000>;
	qcom,nom-batt-capacity-mah = <3000>;
	qcom,batt-id-kohm = <10>;
	qcom,battery-beta = <3435>;
	qcom,battery-type = "carmel_scud_atl";
	qcom,vfloat-batt-warm-mv = <4100>;
	qcom,fastchg-current-ma = <2100>;
	qcom,fg-cc-cv-threshold-mv = <4340>;
	qcom,chg-rslow-comp-c1 = <3316625>;
	qcom,chg-rslow-comp-c2 = <5216676>;
	qcom,chg-rs-to-rslow = <1107683>;
	qcom,chg-rslow-comp-thr = <0xAE>;
	qcom,checksum = <0xB4CB>;
	qcom,gui-version = "PMI8950GUI - 2.0.0.15";
	qcom,fg-profile-data = [
		 D6 83 42 7C 
		 60 80 C3 75 
		 4B 83 11 59 
		 B3 81 B6 8D 
		 EE 81 6D 9B 
		 CE BE 4E D0 
		 56 0E 3D 83 
		 6B 69 9D 61 
		 96 62 33 83 
		 72 79 80 86 
		 1A 82 46 82 
		 01 9A 83 BD 
		 C3 CA 77 13 
		 26 0C BF 59 
		 CE 6E B2 FD 
		 6C 3D 7D 3D 
		 36 3B 00 00 
		 D7 4C 91 33 
		 8E 3A 00 00 
		 00 00 00 00 
		 00 00 00 00 
		 BC 70 F5 6B 
		 DE 6C 7E 81 
		 EC 75 39 69 
		 1F 67 84 79 
		 21 75 58 68 
		 75 6C 2A B8 
		 20 9D 69 7F 
		 67 A0 71 0C 
		 28 00 FF 36 
		 F0 11 30 03 
		 00 00 00 0C 
	];
};
