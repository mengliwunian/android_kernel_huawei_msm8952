/* Copyright (c) 2013, The Linux Foundation. All rights reserved.
 *
 * This program is free software; you can redistribute it and/or modify
 * it under the terms of the GNU General Public License version 2 and
 * only version 2 as published by the Free Software Foundation.
 *
 * This program is distributed in the hope that it will be useful,
 * but WITHOUT ANY WARRANTY; without even the implied warranty of
 * MERCHANTABILITY or FITNESS FOR A PARTICULAR PURPOSE.  See the
 * GNU General Public License for more details.
 */

/*---------------------------------------------------------------------------
 * This file is autogenerated file using gcdb parser. Please do not edit it.
 * Update input XML file to add a new entry or update variable in this file
 * VERSION = "1.0"
 *---------------------------------------------------------------------------*/
&mdss_mdp {
	dsi_jdi_nt35695_5p2_1080pxa_cmd: qcom,mdss_dsi_jdi_nt35695_5p2_1080pxa_cmd {
		qcom,mdss-dsi-panel-name = "JDI_NT35695_5P2_1080PXA_CMD";
		qcom,cont-splash-enabled;
		qcom,mdss-dsi-panel-controller = <&mdss_dsi0>;
		qcom,panel-supply-entries = <&dsi_panel_pwr_supply>;
		qcom,mdss-dsi-panel-type = "dsi_cmd_mode";
		qcom,mdss-dsi-panel-destination = "display_1";
		qcom,mdss-dsi-panel-clockrate = <896000000>;
		qcom,mdss-dsi-panel-framerate = <60>;
		qcom,mdss-dsi-virtual-channel-id = <0>;
		qcom,mdss-dsi-stream = <0>;
		qcom,mdss-dsi-panel-width = <1080>;
		qcom,mdss-dsi-panel-height = <1920>;
		qcom,mdss-dsi-h-front-porch = <45>;
		qcom,mdss-dsi-h-back-porch = <45>;
		qcom,mdss-dsi-h-pulse-width = <8>;
		qcom,mdss-dsi-h-sync-skew = <0>;
		qcom,mdss-dsi-v-back-porch = <16>;
		qcom,mdss-dsi-v-front-porch = <16>;
		qcom,mdss-dsi-v-pulse-width = <4>;
		qcom,mdss-dsi-h-left-border = <0>;
		qcom,mdss-dsi-h-right-border = <0>;
		qcom,mdss-dsi-v-top-border = <0>;
		qcom,mdss-dsi-v-bottom-border = <0>;
		qcom,mdss-dsi-bpp = <24>;
		qcom,mdss-dsi-underflow-color = <0x00>;
		qcom,mdss-dsi-border-color = <0>;
		qcom,mdss-dsi-color-order = "rgb_swap_rgb";
		qcom,mdss-dsi-on-command = [23 01 00 00 00 00 02 FF 20
					23 01 00 00 00 00 02 FB 01
					23 01 00 00 00 00 02 10 01
					23 01 00 00 00 00 02 FF E0
					23 01 00 00 00 00 02 FB 01
					23 01 00 00 00 00 02 B5 86
					23 01 00 00 00 00 02 B6 77
					23 01 00 00 00 00 02 B8 AD
					23 01 00 00 00 00 02 FF 10
					23 01 00 00 00 00 02 FB 01
					15 01 00 00 00 00 02 35 00
					39 01 00 00 00 00 05 2A 00 00 04 37
					39 01 00 00 00 00 05 2B 00 00 07 7F
					39 01 00 00 00 00 03 44 05 00
					05 01 00 00 78 00 02 11 00
					05 01 00 00 14 00 02 29 00];
		qcom,mdss-dsi-off-command = [23 01 00 00 00 00 02 FF 10
					05 01 00 00 14 00 02 28 00
					05 01 00 00 78 00 02 10 00];
		qcom,mdss-dsi-on-command-state = "dsi_lp_mode";
		qcom,mdss-dsi-off-command-state = "dsi_lp_mode";
		qcom,mdss-dsi-h-sync-pulse = <1>;
		qcom,mdss-dsi-traffic-mode = "burst_mode";
		qcom,mdss-dsi-lane-map = "lane_map_0123";
		qcom,mdss-dsi-bllp-eof-power-mode;
		qcom,mdss-dsi-bllp-power-mode;
		qcom,mdss-dsi-lane-0-state;
		qcom,mdss-dsi-lane-1-state;
		qcom,mdss-dsi-lane-2-state;
		qcom,mdss-dsi-lane-3-state;
		qcom,mdss-dsi-te-pin-select = <1>;
		qcom,mdss-dsi-te-v-sync-rd-ptr-irq-line = <0x2c>;
		qcom,mdss-dsi-te-dcs-command = <1>;
		qcom,mdss-dsi-te-check-enable;
		qcom,mdss-dsi-te-using-te-pin;
		qcom,mdss-dsi-panel-timings = [E6 38 26 00 68 6C 2A 3C 2C 03 04 00];
		qcom,mdss-dsi-t-clk-post = <0x2C>;
		qcom,mdss-dsi-t-clk-pre = <0x2B>;
		qcom,mdss-dsi-bl-min-level = <40>;
		qcom,mdss-dsi-bl-max-level = <4095>;
		qcom,mdss-brightness-max-level = <4095>;
		qcom,mdss-dsi-dma-trigger = "trigger_sw";
		qcom,mdss-dsi-mdp-trigger = "none";
		qcom,mdss-dsi-bl-pmic-control-type = "bl_ctrl_wled";
		qcom,panel-dot-inversion-mode-cmds = [29 01 00 00 00 00 02 FF 24
					29 01 00 00 00 00 02 FB 01
					29 01 00 00 00 00 02 9B 01
					29 01 00 00 00 00 02 FF 10
					29 01 00 00 00 00 02 FB 01];
		qcom,panel-column-inversion-mode-cmds = [29 01 00 00 00 00 02 FF 24
					29 01 00 00 00 00 02 FB 01
					29 01 00 00 00 00 02 9B 0F
					29 01 00 00 00 00 02 FF 10
					29 01 00 00 00 00 02 FB 01];
		qcom,dot-inversion-cmds-dsi-state = "dsi_lp_mode";
		qcom,column-inversion-cmds-dsi-state = "dsi_lp_mode";
		qcom,panel-forword-scan-mode-cmds = [29 01 00 00 00 00 02 FF 10
				29 01 00 00 00 00 02 36 00];
		qcom,panel-revert-scan-mode-cmds = [29 01 00 00 00 00 02 FF 10
				29 01 00 00 00 00 02 36 03];
		qcom,forword-scan-cmds-dsi-state = "dsi_lp_mode";
		qcom,revert-scan-cmds-dsi-state = "dsi_lp_mode";
		qcom,panel-shutdown-lcd-ic-sleep-enabled;
		qcom,panel-shutdown-lcd-ic-sleep = [23 01 00 00 00 00 02 4F 01];
		qcom,ic-sleep-cmds-dsi-state = "dsi_lp_mode";
		qcom,mdss-dsi-lp11-init;
		qcom,mdss-pan-physical-width-dimension = <65>;
		qcom,mdss-pan-physical-height-dimension = <115>;
		huawei,delaytime-before-bl = <80>;
		qcom,mdss-dsi-reset-sequence = <1 15>, <0 5>, <1 15>;

	};
};
