 / {
        huawei_fac_info {
                  compatible = "huawei,hw_fac_info";
                  fac,product_name = "HUAWEI VNS";
                  fac,hardware_ver = "HL0VENUSTM";
                  fac,software_ver = "MSM8952_VNS_V0";
                  status = "ok";
        };
};
